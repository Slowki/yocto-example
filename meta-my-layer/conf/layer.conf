## meta-my-layer/conf/layer.conf
```bitbake
# We have a conf and classes directory, add to BBPATH
BBPATH .= ":${LAYERDIR}"

# We have recipes-* directories, add to BBFILES
BBFILES += "${LAYERDIR}/recipes-*/*/*.bb \
            ${LAYERDIR}/recipes-*/*/*.bbappend"

BBFILE_COLLECTIONS += "my-layer"
BBFILE_PATTERN_my-layer = "^${LAYERDIR}/"
BBFILE_PRIORITY_my-layer = "99"

LAYERDEPENDS_my-layer = "my-layer"
LAYERSERIES_COMPAT_my-layer = "styhead kirkstone"
```
